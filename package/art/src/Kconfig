## package/art/src/Kconfig
```kconfig
config QCA_ART
	tristate "atheros art"
	help
	  atheros ar9342 art wireless adjust
```

## package/art_lsdk/src/Kconfig
```kconfig
config QCA_ART_LSDK
	tristate "atheros art2_ver_lsdk"
	help
	  atheros ar9342 art2_ver_lsdk wireless adjust
```

## package/prince/art2_ver_2_23/src/Kconfig
```kconfig
config QCA_ART_2_23
	tristate "atheros art2_ver_2_23"
	help
	  atheros ar9342 qca-art2_ver_2_23 wireless adjust
```

## package/xag/art2_ver_4_9_844/src/Kconfig
```kconfig
config QCA_ART_4_49_844
	tristate "atheros art2_ver_4_9_844"
	help
	  atheros ar9342 art2_ver_4_9_844 wireless adjust
```

## package/xag/art_lsdk_10_2_8/src/Kconfig
```kconfig
config QCA_ART_LSDK
	tristate "atheros art2_ver_lsdk_10_2_8"
	help
	  atheros ar9342 art2_ver_lsdk_10_2_8 wireless adjust
```
